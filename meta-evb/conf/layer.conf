## meta-evb/conf/layer.conf
```bitbake
# We have a conf and classes directory, add to BBPATH
BBPATH .= ":${LAYERDIR}"

BBFILE_COLLECTIONS += "evb"
BBFILE_PATTERN_evb = ""

# should set compat to prevent bb warnings
LAYERSERIES_COMPAT_evb = "honister kirkstone"
```

## meta-evb/meta-evb-ti/conf/layer.conf
```bitbake
# We have a conf and classes directory, add to BBPATH
BBPATH .= ":${LAYERDIR}"

# We have recipes-* directories, add to BBFILES
BBFILES += "${LAYERDIR}/recipes-*/*/*.bb \
            ${LAYERDIR}/recipes-*/*/*.bbappend"

BBFILE_COLLECTIONS += "evb-ti"
BBFILE_PATTERN_evb-ti = "^${LAYERDIR}/"
BBFILE_PRIORITY_evb-ti = "11"

LAYERSERIES_COMPAT_evb-ti = "kirkstone"
```

## meta-evb/meta-evb-ti/meta-evb-beagleboneblack/conf/layer.conf
```bitbake
# We have a conf and classes directory, add to BBPATH
BBPATH .= ":${LAYERDIR}"

# We have recipes-* directories, add to BBFILES
BBFILES += "${LAYERDIR}/recipes-*/*/*.bb \
            ${LAYERDIR}/recipes-*/*/*.bbappend"

BBFILE_COLLECTIONS += "evb-beagleboneblack"
BBFILE_PATTERN_evb-beagleboneblack = "^${LAYERDIR}/"
BBFILE_PRIORITY_evb-beagleboneblack = "12"

LAYERSERIES_COMPAT_evb-beagleboneblack = "kirkstone"
```

## meta-evb/meta-evb-ti/meta-evb-beagleboneblack/conf/machine/beagleboneblack.conf
```bitbake
#@TYPE: Machine
#@NAME: BeagleBone Black machine
#@DESCRIPTION: Machine configuration for the beaglebone black

require conf/machine/beaglebone.conf

KERNEL_IMAGETYPES:append = " zImage"

# only include device specific dtb
KERNEL_DEVICETREE = "am335x-boneblackbmc.dtb"

# generate non-compressed wic image for easier flashing
#IMAGE_FSTYPES:append = " wic"

# Set the root password to '0penBmc'
# Defaults from meta-phosphor/conf/distro/include/phosphor-defaults.inc
require conf/machine/include/obmc-bsp-common.inc
require conf/machine/include/obmc-evb-common.inc

#
# PHOSPHOR OVERRIDES
#

# MLO is at max 128kB
# size = FLASH_UBOOT_SPL_SIZE - FLASH_UBOOT_OFFSET
FLASH_UBOOT_OFFSET:openbmc-phosphor = "0"
FLASH_UBOOT_SPL_SIZE:openbmc-phosphor = "128"

# U-BOOT is at max 2 MB
# size = FLASH_KERNEL_OFFSET - FLASH_UBOOT_OFFSET
MMC_UBOOT_SIZE:openbmc-phosphor = "2048"
FLASH_KERNEL_OFFSET:openbmc-phosphor = "4096"

# kernel is at max 32 MB
# size = FLASH_ROFS_OFFSET - FLASH_KERNEL_OFFSET
FLASH_ROFS_OFFSET:openbmc-phosphor = "65536"

# read-only rootfs is at max 100 MB
# size = FLASH_RWFS_OFFSET - FLASH_ROFS_OFFSET
FLASH_RWFS_OFFSET:openbmc-phosphor = "167936"

# MMC should be at least 1GB in size
FLASH_SIZE:openbmc-phosphor = "1024000"

PREFERRED_PROVIDER_virtual/phosphor-led-manager-config-native:openbmc-phosphor = "beagleboneblack-led-manager-config-native"
```
